/********************************************************************/
// HC12 Program:  CMPE1250 - ICA02
// Processor:     MC9S12XDP512
// Bus Speed:     8 MHz
// Author:        Bigoa Gach
// Details:       This is ICA02: migrating C# to C
                  
// Date:          2021-10-20
// Revision History :
//  each revision will have a date + desc. of changes

/********************************************************************/
// Constant Defines
/********************************************************************/

/********************************************************************/
#include <hidef.h>      /* common defines and macros */
#include "derivative.h" /* derivative-specific definitions */
/********************************************************************/
// Library includes
/********************************************************************/
// your includes go here

 
/********************************************************************/
// Local Prototypes
/********************************************************************/
void RED(Bool bOn);
void GREEN(Bool bOn);
/********************************************************************/
// Global Variables
/********************************************************************/
uint uiMainLoopCount = 0;
/********************************************************************/
// Constants
/********************************************************************/

/********************************************************************/
// Main Entry
/********************************************************************/
void main(void)
{
  // main entry point
  _DISABLE_COP();
  //EnableInterrupts;
  
  /********************************************************************/
  // initializations
  /********************************************************************/
  PT1AD1 &= 0x1F;
  DDR1AD1 = 0xE0;
  ATD1DIEN1 |= 0x1F;
  /********************************************************************/
  // main program loop
  /********************************************************************/
  for (;;)
  {
    uiMainLoopCount += 1;

    RED(uiMainLoopCount < 0x1000);
    GREEN(uiMainLoopCount >= 0x1000);
  }                   
}

/********************************************************************/
// Functions
/********************************************************************/
void RED(Bool bOn)
{
  if (bOn)
  {
    PT1AD1 |= 0x80;
  }
  else
  {
    PT1AD1 &= 0x7F;
  }
}

void GREEN(Bool bOn)
{
  if (bOn)
  {
    PT1AD1 |= 0x20;
  }
  else
  {
    PT1AD1 &= 0xDF;
  }
}
/********************************************************************/
// Interrupt Service Routines
/********************************************************************/
